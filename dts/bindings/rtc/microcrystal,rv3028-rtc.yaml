## dts/bindings/rtc/microcrystal,rv3028-rtc.yaml
```yaml
# Copyright (c) 2024 ANITRA system s.r.o.
# Copyright (c) 2026 Janez Ugovsek <janez@ugovsek.info>
# SPDX-License-Identifier: Apache-2.0

description: Micro Crystal RV3028 RTC, periodic time update and alarm device

compatible: "microcrystal,rv3028-rtc"

include: rtc-device.yaml

properties:
  update-periodic-time:
    type: string
    enum:
      - seconds
      - minutes
    default: seconds
    description: |
      Periodic time update interrupt rate. The RV3028 can generate an update
      interrupt at either the one-second or one-minute update time. If omitted,
      the driver uses seconds.

examples:
  - |
    /* Example node for an RV3028 RTC on the i2c0 bus. */
    &i2c0 {
      status = "okay";
      clock-frequency = <I2C_BITRATE_STANDARD>;

      rv3028: rv3028@52 {
        compatible = "microcrystal,rv3028";
        reg = <0x52>;
        int-gpios = <&gpiob 7 (GPIO_PULL_UP | GPIO_ACTIVE_LOW)>;
        backup-switch-mode = "disabled";
        status = "okay";

        rv3028_rtc: rtc {
          compatible = "microcrystal,rv3028-rtc";
          update-periodic-time = "minutes";
          status = "okay";
        };
      };
    };
```
